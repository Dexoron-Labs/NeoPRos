/* NeoPRos — скрипт линковки ядра.
   Образ загружается Multiboot-загрузчиком по адресу 1 МиБ (0x00100000). */

ENTRY(_start)

SECTIONS
{
    . = 1M;

    /* Адрес, куда загрузчик помещает начало образа. */
    _mb_load_start = .;

    /* Multiboot-заголовок — обязан находиться в первых 8 КиБ образа,
       поэтому кладём его самой первой секцией. */
    .multiboot ALIGN(4) :
    {
        KEEP(*(.multiboot))
    }

    /* Исполняемый код — должен лежать в начале образа,
       т.к. загрузчик передаёт управление на начало файла. */
    .text ALIGN(4K) :
    {
        *(.text .text.*)
    }

    .rodata ALIGN(4K) :
    {
        *(.rodata .rodata.*)
    }

    .data ALIGN(4K) :
    {
        *(.data .data.*)
    }

    .bss ALIGN(4K) :
    {
        *(COMMON)
        *(.bss .bss.*)
    }

    .stack ALIGN(4K) :
    {
        *(.stack .stack.*)
    }
    /* конец данных, попадающих в образ (включая стек) */
    _mb_load_end = .;

    /* конец всей памяти ядра. QEMU требует, чтобы этот адрес был
     * не меньше load_end_addr, поэтому он стоит после стека. */
    _mb_bss_end = .;
}
